## main/Kconfig.projbuild
```kconfig
menu "Wi-Fi Bench Configuration"

    config BENCH_WIFI_SSID
        string "WiFi SSID"
        default "SSID"
        help
            SSID (network name) to join. Maximum 31 characters.

    config BENCH_WIFI_PASSWORD
        string "WiFi Password"
        default "PASSWORD"
        help
            WPA2-Personal password. Leave empty for an open network.
            Maximum 63 characters.

    config BENCH_HOST_IP
        string "Benchmark server IPv4 address"
        default "192.168.0.24"
        help
            IPv4 address of the machine running extras/bench-server
            from esp-hal. The bench uses TCP ports 4321, 4322 and 4323.

endmenu
```

## sdkconfig.defaults.esp32c2
```kconfig
#
# ESP32-C2
#
CONFIG_ESP_WIFI_STATIC_RX_BUFFER_NUM=14
CONFIG_ESP_WIFI_DYNAMIC_RX_BUFFER_NUM=14
CONFIG_ESP_WIFI_DYNAMIC_TX_BUFFER_NUM=18
CONFIG_ESP_WIFI_AMPDU_TX_ENABLED=y
CONFIG_ESP_WIFI_TX_BA_WIN=16
CONFIG_ESP_WIFI_AMPDU_RX_ENABLED=y
CONFIG_ESP_WIFI_RX_BA_WIN=14

CONFIG_LWIP_TCP_RECVMBOX_SIZE=32
CONFIG_LWIP_UDP_RECVMBOX_SIZE=32
CONFIG_LWIP_TCPIP_RECVMBOX_SIZE=32

CONFIG_ESP_DEFAULT_CPU_FREQ_MHZ_120=y
CONFIG_ESP_DEFAULT_CPU_FREQ_MHZ=120

CONFIG_ESPTOOLPY_FLASHMODE_QIO=n
CONFIG_ESPTOOLPY_FLASHFREQ_30M=y

CONFIG_LWIP_TCPIP_CORE_LOCKING=y
CONFIG_LWIP_TCPIP_CORE_LOCKING_INPUT=y
```
